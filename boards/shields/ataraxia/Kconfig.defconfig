## boards/shields/ataraxia/Kconfig.defconfig
```kconfig
# Copyright (c) 2025 The ZMK Contributors
# SPDX-License-Identifier: MIT


if SHIELD_ATARAXIA

config ZMK_KEYBOARD_NAME
    default "ataraxia"

config ZMK_POINTING
    default y

config SPI
    default y

endif
```

## boards/shields/ataraxia/Kconfig.shield
```kconfig
# Copyright (c) 2025 The ZMK Contributors
# SPDX-License-Identifier: MIT

config SHIELD_ATARAXIA
    def_bool $(shields_list_contains,ataraxia)
```

## boards/shields/custom_nice_view_adapter/Kconfig.shield
```kconfig
# Copyright (c) 2025 The ZMK Contributors
# SPDX-License-Identifier: MIT

config SHIELD_CUSTOM_NICE_VIEW_ADAPTER
    def_bool $(shields_list_contains,custom_nice_view_adapter)
```

## boards/shields/settings_reset_ataraxia/Kconfig.defconfig
```kconfig
# Copyright (c) 2020 The ZMK Contributors
# SPDX-License-Identifier: MIT

if SHIELD_SETTINGS_RESET_ATARAXIA

config ZMK_KEYBOARD_NAME
	default "RESET_ATARAXIA"

config SPI
    default y

endif
```
