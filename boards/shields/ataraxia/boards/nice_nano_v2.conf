## boards/shields/settings_reset_ataraxia/Kconfig.defconfig
```kconfig
# Copyright (c) 2020 The ZMK Contributors
# SPDX-License-Identifier: MIT

if SHIELD_SETTINGS_RESET_ATARAXIA

config ZMK_KEYBOARD_NAME
	default "none"

config SPI
    default y

endif
```
